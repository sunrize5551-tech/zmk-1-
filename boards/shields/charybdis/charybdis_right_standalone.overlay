/* boards/shields/charybdis/charybdis_right_standalone.overlay */

#include "charybdis_right_common.dtsi"
#include "charybdis_trackball_processors.dtsi"

/ {
    chosen {
        zmk,kscan = &kscan0;
        zmk,physical-layout = &charybdis_6col_layout;
    };

    trackball_listener: trackball_listener {
        compatible = "zmk,input-listener";
        status = "okay";
        device = <&trackball>;
        
        /* 트랙볼 프로세서 매크로 사용 (원본과 동일) */
        CHARYBDIS_TRACKBALL_PROCESSORS
    };
};
