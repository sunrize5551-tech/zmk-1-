/* boards/shields/charybdis/dongle_nice_64.overlay */
#include "dongle_common.dtsi"
#include "dongle_nice_common.dtsi"

/* 매뉴얼에 나온 대로 1.3인치(128x64) 화면 설정 */
&pro_micro_i2c {
    status = "okay";
    oled: sh1106@3c {
        compatible = "sinowealth,sh1106";
        reg = <0x3c>;
        width = <128>;
        height = <64>;
        segment-offset = <2>;
        page-offset = <0>;
        display-offset = <0>;
        multiplex-ratio = <63>;
        segment-remap;
        com-invdir;
        prechargep = <0x22>;
    };
};

/* 동글에서 키보드 스캔/트랙볼은 필요 없으므로 비활성화 */
&kscan0 {
    status = "disabled";
};
